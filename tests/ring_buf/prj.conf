## CMakeLists.txt
```
cmake_minimum_required(VERSION 3.20.0)
find_package(Zephyr REQUIRED HINTS $ENV{ZEPHYR_BASE})
project(test_ring_buf)

target_include_directories(app PRIVATE src)

target_sources(app PRIVATE
    src/ring_buf.c
    src/test_ring_buf.c
)
```

## prj.conf
```kconfig
# Enable the Ztest unit testing framework
CONFIG_ZTEST=y

# Randomize suite and test order to catch ordering dependencies early
CONFIG_ZTEST_SHUFFLE=y

# Enable logging
CONFIG_LOG=y
```

## src/coverage_runner.c
```c
/*
 * SPDX-License-Identifier: Apache-2.0
 *
 * Standalone coverage driver for ring_buf.
 *
 * Mirrors every ZTEST case from test_ring_buf.c but uses only the C
 * standard library (assert, stdio) so it compiles without Zephyr.
 * Build with:
 *   clang --coverage -I. -o rb_runner ring_buf.c coverage_runner.c
 * Then run ./rb_runner and invoke gcovr / llvm-cov gcov.
 */

#include <stdio.h>
#include <assert.h>
#include <stdint.h>
#include <stddef.h>
#include "ring_buf.h"

#define BUF_SIZE 4U

static uint8_t      storage[BUF_SIZE];
static struct app_rb rb;

#define RUN(fn) \
	do { fn(); printf("PASS  %s\n", #fn); } while (0)

/* ------------------------------------------------------------------ */
/* Suite: ring_buf_init                                                 */
/* ------------------------------------------------------------------ */

static void test_init_basic(void)
{
	app_rb_init(&rb, BUF_SIZE, storage);
	assert(app_rb_is_empty(&rb));
	assert(!app_rb_is_full(&rb));
}

static void test_reinit_clears_state(void)
{
	app_rb_init(&rb, BUF_SIZE, storage);
	app_rb_push(&rb, 0xAAU);
	app_rb_push(&rb, 0xBBU);

	app_rb_init(&rb, BUF_SIZE, storage);
	assert(rb.count    == 0U);
	assert(rb.head     == 0U);
	assert(rb.tail     == 0U);
	assert(app_rb_is_empty(&rb));
	assert(!app_rb_is_full(&rb));
}

/* ------------------------------------------------------------------ */
/* Suite: ring_buf_push_pop                                             */
/* ------------------------------------------------------------------ */

static void test_push_pop_single(void)
{
	app_rb_init(&rb, BUF_SIZE, storage);
	assert(app_rb_push(&rb, 0x42U) == 0);
	uint8_t out = 0U;
	assert(app_rb_pop(&rb, &out) == 0);
	assert(out == 0x42U);
	assert(app_rb_is_empty(&rb));
}

static void test_fifo_order(void)
{
	app_rb_init(&rb, BUF_SIZE, storage);
	app_rb_push(&rb, 1U);
	app_rb_push(&rb, 2U);
	app_rb_push(&rb, 3U);
	uint8_t a = 0, b = 0, c = 0;
	app_rb_pop(&rb, &a);
	app_rb_pop(&rb, &b);
	app_rb_pop(&rb, &c);
	assert(a == 1U);
	assert(b == 2U);
	assert(c == 3U);
}

static void test_full_buf_push_fails(void)
{
	app_rb_init(&rb, BUF_SIZE, storage);
	for (size_t i = 0; i < BUF_SIZE; i++) {
		assert(app_rb_push(&rb, (uint8_t)i) == 0);
	}
	assert(app_rb_push(&rb, 0xFFU) == -ENOMEM);
	assert(app_rb_is_full(&rb));
}

/* ------------------------------------------------------------------ */
/* Suite: ring_buf_boundaries                                           */
/* ------------------------------------------------------------------ */

static void test_peek_non_consuming(void)
{
	app_rb_init(&rb, BUF_SIZE, storage);
	app_rb_push(&rb, 0x55U);
	uint8_t peeked = 0U;
	assert(app_rb_peek(&rb, &peeked) == 0);
	assert(peeked == 0x55U);
	assert(rb.count == 1U);          /* still in buffer */
	uint8_t popped = 0U;
	assert(app_rb_pop(&rb, &popped) == 0);
	assert(popped == 0x55U);
	assert(app_rb_is_empty(&rb));
}

static void test_pop_null_discards(void)
{
	app_rb_init(&rb, BUF_SIZE, storage);
	app_rb_push(&rb, 0xDEU);
	assert(app_rb_pop(&rb, NULL) == 0);
	assert(app_rb_is_empty(&rb));
}

static void test_is_full_after_fill(void)
{
	app_rb_init(&rb, BUF_SIZE, storage);
	assert(!app_rb_is_full(&rb));
	for (size_t i = 0; i < BUF_SIZE - 1U; i++) {
		app_rb_push(&rb, (uint8_t)i);
		assert(!app_rb_is_full(&rb));
	}
	app_rb_push(&rb, 0xFFU);
	assert(app_rb_is_full(&rb));
	assert(!app_rb_is_empty(&rb));
}

/* ------------------------------------------------------------------ */
/* Error-path coverage (pop/peek on empty)                             */
/* ------------------------------------------------------------------ */

static void test_empty_errors(void)
{
	app_rb_init(&rb, BUF_SIZE, storage);
	uint8_t dummy = 0U;
	assert(app_rb_pop(&rb, &dummy)  == -ENODATA);
	assert(app_rb_peek(&rb, &dummy) == -ENODATA);
}

/* ------------------------------------------------------------------ */

int main(void)
{
	printf("=== ring_buf coverage runner ===\n");
	RUN(test_init_basic);
	RUN(test_reinit_clears_state);
	RUN(test_push_pop_single);
	RUN(test_fifo_order);
	RUN(test_full_buf_push_fails);
	RUN(test_peek_non_consuming);
	RUN(test_pop_null_discards);
	RUN(test_is_full_after_fill);
	RUN(test_empty_errors);
	printf("=== All 9 cases passed ===\n");
	return 0;
}
```

## src/ring_buf.c
```c
/*
 * SPDX-License-Identifier: Apache-2.0
 *
 * ring_buf — circular FIFO byte buffer implementation.
 */

#include "ring_buf.h"

void app_rb_init(struct app_rb *buf, size_t capacity, uint8_t *data)
{
	buf->data     = data;
	buf->capacity = capacity;
	buf->head     = 0;
	buf->tail     = 0;
	buf->count    = 0;
}

int app_rb_push(struct app_rb *buf, uint8_t item)
{
	if (buf->count == buf->capacity) {
		return -ENOMEM;
	}

	buf->data[buf->tail] = item;
	buf->tail = (buf->tail + 1) % buf->capacity;
	buf->count++;
	return 0;
}

int app_rb_pop(struct app_rb *buf, uint8_t *item)
{
	if (buf->count == 0) {
		return -ENODATA;
	}

	if (item != NULL) {
		*item = buf->data[buf->head];
	}

	buf->head = (buf->head + 1) % buf->capacity;
	buf->count--;
	return 0;
}

int app_rb_peek(struct app_rb *buf, uint8_t *item)
{
	if (buf->count == 0) {
		return -ENODATA;
	}

	*item = buf->data[buf->head];
	return 0;
}

bool app_rb_is_empty(struct app_rb *buf)
{
	return buf->count == 0;
}

bool app_rb_is_full(struct app_rb *buf)
{
	return buf->count == buf->capacity;
}
```

## src/ring_buf.h
```c
/*
 * SPDX-License-Identifier: Apache-2.0
 *
 * ring_buf — minimal circular FIFO byte buffer.
 */

#ifndef RING_BUF_H_
#define RING_BUF_H_

#include <stdint.h>
#include <stddef.h>
#include <stdbool.h>
#include <errno.h>

/* ENODATA (61) is POSIX but absent from some libc variants; guard it. */
#ifndef ENODATA
#define ENODATA 61
#endif

struct app_rb {
	uint8_t *data;
	size_t   capacity;
	size_t   head;   /* index of the next byte to read  */
	size_t   tail;   /* index of the next byte to write */
	size_t   count;  /* number of bytes currently held  */
};

/**
 * @brief Initialise (or re-initialise) the ring buffer.
 *
 * Resets head, tail and count to 0.  Safe to call on an already-used
 * buffer — this is the "reinit clears state" guarantee the tests check.
 *
 * @param buf      Buffer descriptor.
 * @param capacity Maximum number of bytes the storage array can hold.
 * @param data     Backing storage array of at least @p capacity bytes.
 */
void app_rb_init(struct app_rb *buf, size_t capacity, uint8_t *data);

/**
 * @brief Push one byte onto the back of the buffer.
 *
 * @return 0 on success, -ENOMEM if the buffer is full.
 */
int app_rb_push(struct app_rb *buf, uint8_t item);

/**
 * @brief Pop one byte from the front of the buffer.
 *
 * @param item  Destination for the byte.  Pass NULL to discard without
 *              storing the value — the byte is still consumed.
 * @return 0 on success, -ENODATA if the buffer is empty.
 */
int app_rb_pop(struct app_rb *buf, uint8_t *item);

/**
 * @brief Peek at the next byte without consuming it.
 *
 * @return 0 on success, -ENODATA if the buffer is empty.
 */
int app_rb_peek(struct app_rb *buf, uint8_t *item);

/** @return true when the buffer holds no bytes. */
bool app_rb_is_empty(struct app_rb *buf);

/** @return true when the buffer is at capacity. */
bool app_rb_is_full(struct app_rb *buf);

#endif /* RING_BUF_H_ */
```

## src/test_ring_buf.c
```c
/*
 * Ring Buffer Module - Homework Test Skeleton
 *
 * test_fresh_state is provided as a worked example. Fill in the remaining
 * 7 ZTEST bodies according to TEST_SPEC.md. Stubs call ztest_test_skip()
 * so the binary builds and runs cleanly before each test is implemented.
 *
 * Run:
 *   west twister -T tests/ring_buf -p native_sim
 */

#include <zephyr/ztest.h>
#include <errno.h>

#include "ring_buf.h"

/*
 * Shared before hook: every suite reinitialises the ring buffer with a
 * capacity of 4 so tests start from a clean, known state. Capacity 4 is
 * enough to exercise FIFO order (push 1, 2, 3) and overflow (full at 4).
 */
static void before(void *f)
{
	ARG_UNUSED(f);
	rb_init(4);
}

/*
 * ============================================================================
 * Test Suite: ring_buf_init
 *
 * Initial state and re-initialization behaviour.
 * ============================================================================
 */
ZTEST_SUITE(ring_buf_init, NULL, NULL, before, NULL, NULL);

/* PROVIDED — study this test before writing the rest. */
ZTEST(ring_buf_init, test_fresh_state)
{
	zassert_true(rb_is_empty(), "Fresh buffer must be empty");
	zassert_equal(rb_count(), 0, "Fresh buffer count must be 0");
}

ZTEST(ring_buf_init, test_reinit_clears_state)
{
	/* TODO(l8-task1): Push a value, call rb_init(4) again, then
	 * verify the buffer is empty and count is 0.
	 * See TEST_SPEC.md "Suite ring_buf_init" #2.
	 */
	ztest_test_skip();
}

/*
 * ============================================================================
 * Test Suite: ring_buf_push_pop
 *
 * Single push/pop round-trip, FIFO order, full error path.
 * ============================================================================
 */
ZTEST_SUITE(ring_buf_push_pop, NULL, NULL, before, NULL, NULL);

ZTEST(ring_buf_push_pop, test_single_push_pop)
{
	/* TODO(l8-task1): rb_push(42), rb_pop(&v) -> v == 42, buffer empty after.
	 * See TEST_SPEC.md "Suite ring_buf_push_pop" #1.
	 */
	ztest_test_skip();
}

ZTEST(ring_buf_push_pop, test_fifo_order)
{
	/* TODO(l8-task1): rb_push(1), rb_push(2), rb_push(3); pop three times
	 * and verify the values come out as 1, 2, 3 in that order.
	 * See TEST_SPEC.md "Suite ring_buf_push_pop" #2.
	 */
	ztest_test_skip();
}

ZTEST(ring_buf_push_pop, test_push_full_returns_enospc)
{
	/* TODO(l8-task1): Fill the buffer to its capacity of 4, then push
	 * one more value -> -ENOSPC.
	 * See TEST_SPEC.md "Suite ring_buf_push_pop" #3.
	 */
	ztest_test_skip();
}

/*
 * ============================================================================
 * Test Suite: ring_buf_boundaries
 *
 * Peek semantics and NULL-pointer boundary conditions.
 * ============================================================================
 */
ZTEST_SUITE(ring_buf_boundaries, NULL, NULL, before, NULL, NULL);

ZTEST(ring_buf_boundaries, test_peek_does_not_consume)
{
	/* TODO(l8-task1): rb_push(7); rb_peek(&v) -> v == 7; rb_peek(&v) again
	 * -> v == 7; rb_count() still == 1.
	 * See TEST_SPEC.md "Suite ring_buf_boundaries" #1.
	 */
	ztest_test_skip();
}

ZTEST(ring_buf_boundaries, test_pop_null_returns_einval)
{
	/* TODO(l8-task1): rb_pop(NULL) -> -EINVAL.
	 * See TEST_SPEC.md "Suite ring_buf_boundaries" #2.
	 */
	ztest_test_skip();
}

ZTEST(ring_buf_boundaries, test_is_full_after_fill)
{
	/* TODO(l8-task1): push 4 values -> rb_is_full() == true, rb_count() == 4.
	 * See TEST_SPEC.md "Suite ring_buf_boundaries" #3.
	 */
	ztest_test_skip();
}
```
