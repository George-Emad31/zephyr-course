## app/drivers/sensor/led_sensor/Kconfig
```kconfig
# SPDX-License-Identifier: Apache-2.0

config LED_SENSOR
	bool "LED Sensor driver"
	default y
	depends on DT_HAS_ZEPHYR_LED_SENSOR_ENABLED
	select GPIO
	help
	  Enable the LED sensor driver that exposes an on-board LED
	  via the Zephyr sensor API. sensor_sample_fetch turns the LED
	  on; sensor_channel_get turns it off.
```

## boards/my_esp32_devkitc/board.yml
```yaml
board:
  name: my_esp32_devkitc
  full_name: My ESP32-DevKitC
  vendor: espressif
  socs:
  - name: esp32
```

## boards/my_scratch_board/Kconfig
```kconfig
# Copyright (c) 2024 My Project
# SPDX-License-Identifier: Apache-2.0

config HEAP_MEM_POOL_ADD_SIZE_BOARD
	int
	default 4096 if BOARD_MY_SCRATCH_BOARD_ESP32_PROCPU
```

## boards/my_scratch_board/Kconfig.my_scratch_board
```kconfig
# Copyright (c) 2024 My Project
# SPDX-License-Identifier: Apache-2.0

config BOARD_MY_SCRATCH_BOARD
	select SOC_ESP32_WROVER_E_N4R8
	select SOC_ESP32_PROCPU if BOARD_MY_SCRATCH_BOARD_ESP32_PROCPU
```

## boards/my_scratch_board/board.yml
```yaml
board:
  name: my_scratch_board
  full_name: My Scratch Board
  vendor: espressif
  socs:
  - name: esp32
```

## boards/my_scratch_board/my_scratch_board_procpu_defconfig
```kconfig
# Copyright (c) 2024 My Project
# SPDX-License-Identifier: Apache-2.0

CONFIG_CONSOLE=y
CONFIG_SERIAL=y
CONFIG_UART_CONSOLE=y
CONFIG_LOG=n

CONFIG_GPIO=y
```
